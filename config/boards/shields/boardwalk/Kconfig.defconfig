## config/boards/shields/boardwalk/Kconfig.defconfig
```kconfig
# Copyright (c) 2020 Pete Johanson, Richard Jones
# SPDX-License-Identifier: MIT

if SHIELD_BOARDWALK

config ZMK_KEYBOARD_NAME
	default "Boardwalk"

endif
```

## config/west.yml
```yaml
manifest:
  remotes:
    - name: kaylanm
      url-base: https://github.com/kaylanm
  projects:
    - name: zmk
      remote: kaylanm
      revision: boardwalk
      import: app/west.yml
  self:
    path: config
```
